/*
 * result.c
 *
 *  Created on: Jan 10, 2023
 *      Author: fil
 */

#include "main.h"

const uint16_t	sine_in[NUM_SINEVAR] =
{
		0x0,0x1,0x2,0x6,0xa,0xf,0x16,0x1e,
		0x27,0x32,0x3d,0x4a,0x58,0x67,0x78,0x89,
		0x9c,0xb0,0xc5,0xdb,0xf2,0x10a,0x123,0x13e,
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		0x27,0x1e,0x16,0xf,0xa,0x6,0x2,0x1,
};
uint16_t	sine_tab[NUM_SAMPLES];

const float amplitude_table[AMPLITUDE_TABLE_LEN] =
{
		0.3F,
		0.275F,
		0.25F,
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		0.01F,
};

const uint8_t amplitude_table_gain[AMPLITUDE_TABLE_LEN] =
{
		1,
		2,
		3,
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		13,
		14
};

void scale_down_sine( void )
{
uint32_t	i,k=0;
	for(i=0;i<NUM_SAMPLES;i++)
		sine_tab[i] = 0;

	for(i=FLOOR_SAMPLES;i<NUM_SAMPLES-NUM_SINEVAR;i++)
	{
		sine_tab[i] = (uint16_t )((float )(sine_in[k]) * SystemVar.f_wave_amplitude + (float )SINE_OFFSET);
		k++;
		k &= 0xff;
	}
}

void set_wave_amplitude(uint8_t amplitude_index)
{
	if ( amplitude_index < AMPLITUDE_TABLE_LEN)
	{
		SystemVar.f_wave_amplitude = amplitude_table[amplitude_index];
	    scale_down_sine();
	}
}

void set_opamp_gain(uint32_t gain)
{
	SystemVar.pga_gain = gain;
	//ram_board_parameters.scale_factor = SystemVar.pga_gain >> 14;
	hopamp1.Init.PgaGain = gain;
	HAL_OPAMP_Init(&hopamp1);
}

#define	MAX_PEAK	(2048+64)
#define	MIN_PEAK	(2048-64)

void get_peak(void)
{
uint32_t	i;
uint32_t	adjust = 0;

	SystemVar.peak=0;
	SystemVar.f_floor_noise = 0.0F;
	for(i=FLOOR_START;i<FLOOR_END;i++)
	{
		SystemVar.f_floor_noise += (float )SystemVar.sensor_dma_data[i];
	}
	SystemVar.f_floor_noise = SystemVar.f_floor_noise / FLOOR_NUMBER;
	SystemVar.f_floor_noise /= (float )(amplitude_table_gain[SystemVar.wave_amplitude_index]);

	for(i=FLOOR_SAMPLES+256;i<NUM_SAMPLES-1024;i++)
	{
		if ( SystemVar.sensor_dma_data[i] > SystemVar.peak)
			SystemVar.peak = SystemVar.sensor_dma_data[i];
	}

	if ( SystemVar.peak > MAX_PEAK )
	{
		if ( SystemVar.wave_amplitude_index < (AMPLITUDE_TABLE_LEN - 1))
		{
			adjust = 1;
			SystemVar.wave_amplitude_index++;
		}
	}
	else
	{
		if ( SystemVar.peak < MIN_PEAK )
		{
			if ( SystemVar.wave_amplitude_index > 0 )
			{
				adjust = 2;
				SystemVar.wave_amplitude_index--;
			}
		}
	}
	if ( adjust )
		set_wave_amplitude(SystemVar.wave_amplitude_index);
}

void get_temperature(void)
{
	if ( ( SystemVar.system_flags & FLAGS_TEMP_COMPLETE) == FLAGS_TEMP_COMPLETE)
	{
		SystemVar.system_flags &= ~FLAGS_TEMP_COMPLETE;
		SystemVar.temperature[0] = SystemVar.running_temperature[0];
		SystemVar.temperature[1] = SystemVar.running_temperature[1];
		SystemVar.temperature[2] = SystemVar.running_temperature[2];
		SystemVar.temperature[3] = SystemVar.running_temperature[3];
		SystemVar.temperature[2] =  __LL_ADC_CALC_VREFANALOG_VOLTAGE(SystemVar.temperature[1],LL_ADC_RESOLUTION_12B);
		SystemVar.temperature[3] =  __LL_ADC_CALC_TEMPERATURE(SystemVar.temperature[2],SystemVar.temperature[0],LL_ADC_RESOLUTION_12B);
	}
}

void get_result(void)
{
	get_peak();
	get_temperature();
	SystemVar.pkt_indicator = 'V';
}

void send_results(void)
{
	sprintf((char *)SystemVar.uart_buf,"<%c %d %d %d %d>\r\n",
			SystemVar.pkt_indicator,
			(int )(SystemVar.peak),
			(int )(amplitude_table_gain[SystemVar.wave_amplitude_index]),
			(int )SystemVar.f_floor_noise,
			(int )SystemVar.temperature[3]);
	tx_uart();
}

